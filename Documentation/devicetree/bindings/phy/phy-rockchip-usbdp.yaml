## Documentation/devicetree/bindings/phy/phy-rockchip-usbdp.yaml
```yaml
# SPDX-License-Identifier: (GPL-2.0-only OR BSD-2-Clause)
%YAML 1.2
---
$id: http://devicetree.org/schemas/phy/phy-rockchip-usbdp.yaml#
$schema: http://devicetree.org/meta-schemas/core.yaml#

title: Rockchip USBDP Combo PHY with Samsung IP block

maintainers:
  - Frank Wang <frank.wang@rock-chips.com>
  - Zhang Yubing <yubing.zhang@rock-chips.com>

properties:
  compatible:
    enum:
      - rockchip,rk3588-usbdp-phy

  reg:
    maxItems: 1

  clocks:
    items:
      - description: phy ref clock.
      - description: phy pcs immortal clock.
      - description: phy peripheral clock.
      - description: USB2 PHY UTMI clock.

  clock-names:
    items:
      - const: refclk
      - const: immortal
      - const: pclk
      - const: utmi

  resets:
    items:
      - description: phy init reset.
      - description: phy cmn reset.
      - description: phy lane reset.
      - description: phy pcs apb reset.
      - description: phy pma apb reset.

  reset-names:
    items:
      - const: init
      - const: cmn
      - const: lane
      - const: pcs_apb
      - const: pma_apb

  rockchip,dp-lane-mux:
    $ref: /schemas/types.yaml#/definitions/uint32-array
    minItems: 2
    maxItems: 4
    description:
      An array of physical Tyep-C lanes indexes. Position of an entry determines
      the dp lane index, while the value of an entry indicater physical Type-C lane.
      The support dp lanes number are 2 or 4. e.g. for 2 lanes dp lanes map, we could
      have "rockchip,dp-lane-mux = <2, 3>;", assuming dp lane0 on Type-C phy lane2,
      dp lane1 on Type-C phy lane3. For 4 lanes dp lanes map, we could have
      "rockchip,dp-lane-mux = <0, 1, 2, 3>;", assuming dp lane0 on Type-C phy lane0,
      dp lane1 on Type-C phy lane1, dp lane2 on Type-C phy lane2, dp lane3 on Type-C
      phy lane3. If dp lane map by DisplayPort Alt mode, this property is not need.

  orientation-switch:
    type: boolean
    description: The PHY handles Type-C orientation switching.

  svid:
    $ref: /schemas/types.yaml#/definitions/uint32
    const: 0xff01
    description: DisplayPort Standard or Vendor ID used for Type-C Alt Mode.

  sbu1-dc-gpios:
    maxItems: 1
    description: GPIO controlling the SBU1 DC path.

  sbu2-dc-gpios:
    maxItems: 1
    description: GPIO controlling the SBU2 DC path.

  maximum-speed:
    $ref: /schemas/usb/usb.yaml#/properties/maximum-speed

  port:
    $ref: /schemas/graph.yaml#/properties/port
    description:
      OF graph connection to the Type-C orientation switch or Alt Mode mux.

  rockchip,u2phy-grf:
    $ref: /schemas/types.yaml#/definitions/phandle
    description:
      Phandle to the syscon managing the 'usb2 phy general register files'.

  rockchip,usb-grf:
    $ref: /schemas/types.yaml#/definitions/phandle
    description:
      Phandle to the syscon managing the 'usb general register files'.

  rockchip,usbdpphy-grf:
    $ref: /schemas/types.yaml#/definitions/phandle
    description:
      Phandle to the syscon managing the 'usbdp phy general register files'.

  rockchip,vo-grf:
    $ref: /schemas/types.yaml#/definitions/phandle
    description:
      Phandle to the syscon managing the 'video output general register files'.
      When select the dp lane mapping will request its phandle.

  rockchip,usbdpphy-clamp:
    $ref: /schemas/types.yaml#/definitions/phandle
    description: When set, clamp phy output. Only work when usbdpphy power off.

  dp-port:
    type: object
    additionalProperties: false

    properties:
      "#phy-cells":
        const: 0

    required:
      - "#phy-cells"

  u3-port:
    type: object
    additionalProperties: false

    properties:
      "#phy-cells":
        const: 0

    required:
      - "#phy-cells"

required:
  - compatible
  - reg
  - clocks
  - clock-names
  - resets
  - reset-names
  - dp-port
  - u3-port

dependencies:
  orientation-switch: [ port ]
  svid: [ port ]

additionalProperties: false

examples:
  - |
    #include <dt-bindings/clock/rk3588-cru.h>

    usbdp_phy0: phy@fed80000 {
      compatible = "rockchip,rk3588-usbdp-phy";
      reg = <0xfed80000 0x10000>;
      rockchip,u2phy-grf = <&usb2phy0_grf>;
      rockchip,usb-grf = <&usb_grf>;
      rockchip,usbdpphy-grf = <&usbdpphy0_grf>;
      rockchip,vo-grf = <&vo0_grf>;
      clocks = <&cru CLK_USBDPPHY_MIPIDCPPHY_REF>,
               <&cru CLK_USBDP_PHY0_IMMORTAL>,
               <&cru PCLK_USBDPPHY0>,
               <&u2phy0>;
      clock-names = "refclk", "immortal", "pclk", "utmi";
      resets = <&cru SRST_USBDP_COMBO_PHY0_INIT>,
               <&cru SRST_USBDP_COMBO_PHY0_CMN>,
               <&cru SRST_USBDP_COMBO_PHY0_LANE>,
               <&cru SRST_USBDP_COMBO_PHY0_PCS>,
               <&cru SRST_P_USBDPPHY0>;
      reset-names = "init", "cmn", "lane", "pcs_apb", "pma_apb";
      status = "disabled";

      usbdp_phy0_dp: dp-port {
        #phy-cells = <0>;
        status = "disabled";
      };

      usbdp_phy0_u3: u3-port {
        #phy-cells = <0>;
        status = "disabled";
      };
    };
```

## Documentation/devicetree/bindings/usb/embedfire,rk3588-lubancat-5-usb-c-lane-manager.yaml
```yaml
# SPDX-License-Identifier: (GPL-2.0-only OR BSD-2-Clause)
%YAML 1.2
---
$id: http://devicetree.org/schemas/usb/embedfire,rk3588-lubancat-5-usb-c-lane-manager.yaml#
$schema: http://devicetree.org/meta-schemas/core.yaml#

title: EmbedFire LubanCat-5 USB-C SuperSpeed Lane Manager

maintainers:
  - EmbedFire <embedfire@embedfire.com>

description: |
  Board-level coordinator for LubanCat-5 USB-C ports. A standards-valid CC
  orientation, when present, is forwarded to the USB3 PHY. Otherwise, a local
  FUSB302 CC sample or an attach indication from the paired USB2 PHY starts a
  bounded two-orientation search which is confirmed by USB SuperSpeed
  enumeration. A sampled local CC orientation is only the first candidate; it
  does not describe the orientation at the far end of a Type-C cable.

properties:
  compatible:
    const: embedfire,rk3588-lubancat-5-usb-c-lane-manager

  phys:
    maxItems: 1

  phy-names:
    items:
      - const: usb2

  embedfire,usb-controller:
    $ref: /schemas/types.yaml#/definitions/phandle
    description:
      DWC3 controller whose port 1 is paired with the USB2 PHY and orientation
      switch.

  orientation-switch:
    type: boolean
    description:
      The manager accepts a standards-based Type-C orientation input.

  port:
    $ref: /schemas/graph.yaml#/properties/port
    description: Output to the USB3 PHY when there is no orientation input.

  ports:
    $ref: /schemas/graph.yaml#/properties/ports

    properties:
      port@0:
        $ref: /schemas/graph.yaml#/properties/port
        description: Output to the USB3 PHY orientation switch.

      port@1:
        $ref: /schemas/graph.yaml#/properties/port
        description: Optional input from a Type-C connector.

    required:
      - port@0

allOf:
  - if:
      required:
        - orientation-switch
    then:
      required:
        - ports
      properties:
        port: false
        ports:
          required:
            - port@1
    else:
      required:
        - port
      properties:
        ports: false

required:
  - compatible
  - phys
  - phy-names
  - embedfire,usb-controller

additionalProperties: false

examples:
  - |
    usb-c-lane-manager {
        compatible = "embedfire,rk3588-lubancat-5-usb-c-lane-manager";
        phys = <&u2phy1_otg>;
        phy-names = "usb2";
        embedfire,usb-controller = <&usbdrd_dwc3_1>;

        port {
            lane_manager_orientation: endpoint {
                remote-endpoint = <&usbdp_phy1_orientation>;
            };
        };
    };
...
```

## Documentation/devicetree/bindings/usb/fcs,fusb302.txt
```
Fairchild FUSB302 Type-C Port controllers

Required properties :
- compatible             : "fcs,fusb302"
- reg                    : I2C slave address
- interrupts             : Interrupt specifier

Required sub-node:
- connector : The "usb-c-connector" attached to the FUSB302 IC. The bindings
  of the connector node are specified in:

	Documentation/devicetree/bindings/connector/usb-connector.yaml

Optional properties:
- fcs,sink-cc-orientation-probe : Enables a board-specific workaround for a
  fixed-Sink port connected to a peer which also presents Rd and therefore
  cannot produce a normal TCPM orientation event. The FUSB302 briefly probes
  each CC pin with default Rp while retaining Rd on the other pin, restores
  the fixed-Sink state before Type-C attach debounce can complete, and only
  forwards the measured local plug orientation to the orientation switch.
  The local CC state does not reveal the far-end plug orientation. This
  property never permits the driver to enable the VBUS regulator and must not
  be used on a Source or dual-power-role port.


Example:

fusb302: typec-portc@54 {
	compatible = "fcs,fusb302";
	reg = <0x54>;
	interrupt-parent = <&nmi_intc>;
	interrupts = <0 IRQ_TYPE_LEVEL_LOW>;

	usb_con: connector {
		compatible = "usb-c-connector";
		label = "USB-C";
		power-role = "dual";
		try-power-role = "sink";
		source-pdos = <PDO_FIXED(5000, 3000, PDO_FIXED_USB_COMM)>;
		sink-pdos = <PDO_FIXED(5000, 3000, PDO_FIXED_USB_COMM)
			     PDO_VAR(3000, 12000, 3000)
			     PDO_PPS_APDO(3000, 11000, 3000)>;
		op-sink-microwatt = <10000000>;
	};
};
```

## drivers/misc/rockchip/Kconfig
```kconfig
# SPDX-License-Identifier: GPL-2.0
#
# Misc strange devices for rockchip

config PCIE_FUNC_RKEP
	tristate "Rockchip PCIe EP function driver"
	depends on PCI
	depends on ARCH_ROCKCHIP
	select PCIE_DW_DMATEST
	help
           Enable this configuration option to enable the host side function
	   driver for Rockchip's EP demo function driver.

config PCIE_FUNC_RKEP_USERPAGES
	bool "EP function driver reserve continuous physical space for user layer"
	depends on PCIE_FUNC_RKEP=y
	help
	  Enable this configuration option to reserve continuous physical space
          for user layer in Rockchip's EP demo function driver.

config ROCKCHIP_LTC_SPI
	tristate "Rockchip SPI MOSI LTC generator"
	depends on ARCH_ROCKCHIP || COMPILE_TEST
	depends on OF && HAS_IOMEM && DMA_ENGINE
	depends on COMMON_CLK
	help
	  Dedicated LTC timecode generator for Rockchip SPI controllers.
	  The driver owns the SPI controller directly and streams one-bit
	  samples on MOSI using TX DMA. On RK3588 LubanCat-5 this is intended
	  for SPI0_MOSI_M2 / GPIO1_B2 and exposes /dev/ltc0.

	  To build it as a module, choose M here. The module will be called
	  rockchip-ltc-spi.
```
